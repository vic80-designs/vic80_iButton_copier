;================================================================
; ПП инициализации всего и вся
;================================================================

;++++++++++++++++++++++++++++++++++++++++++++++++++++++++++++++++
;Таблица векторов прерываний
;++++++++++++++++++++++++++++++++++++++++++++++++++++++++++++++++

	.org	0x0000
	rjmp	init
	.org	OC1Aaddr							; Совпадение TMR1
	rjmp	Soft_timer

init:
	ldi		tempreg,low(RAMEND)					;Инициализация стека
	out		SPl,tempreg							;Обязательно!!!
	ldi		tempreg,high(RAMEND)				;Инициализация стека
	out		SPh,tempreg							;Обязательно!!!

;----------------------------------------------------------------
; Выключаем аналоговый компаратор
;----------------------------------------------------------------
	ldi		tempreg,(1<<ACD)
	out		ACSR,tempreg

;----------------------------------------------------------------
; пауза для инициализации периферии
;----------------------------------------------------------------
	ser		Zh
	ser		Zl
	sbiw	Z,1
	brne	pc-1

;----------------------------------------------------------------
; инициализируем флаги
;----------------------------------------------------------------	
	clr		flags

;----------------------------------------------------------------
; инициализируем регистр выбора режима работы
;----------------------------------------------------------------	
	ldi		mode,(1<<selection_mode|1<<read_mode)
	
;----------------------------------------------------------------
; очищаем память под серийный номер
;----------------------------------------------------------------
	
	clr		tempreg
	ldi		Zl,low(ibutton_ser_no)
	ldi		Zh,high(ibutton_ser_no)
	ldi		tempreg2,8

	st		Z+,tempreg
	dec		tempreg2
	brne	pc-2
	
	rjmp	InitPeriphery

;++++++++++++++++++++++++++++++++++++++++++++++++++++++++++++++++
; Другие инклюды
;++++++++++++++++++++++++++++++++++++++++++++++++++++++++++++++++

	.include	"LCD_HD44780\Init_LCD_HD44780.asm"
	.include	"Buttons\Init_ButOpros.asm"
	.include	"Buzzer\Init_Buzzer.asm"
	.include	"Blinker\Init_Blinker.asm"
	.include	"SoftTimer\Init_SoftTimer.asm"
	.include	"OneWire\Init_OneWire.asm"

;++++++++++++++++++++++++++++++++++++++++++++++++++++++++++++++++
; Начало инициализации 
;++++++++++++++++++++++++++++++++++++++++++++++++++++++++++++++++
InitPeriphery:

	rcall	lcd_init
	rcall	buzzer_init
	rcall	blinker_init
	rcall	SoftTimer_init
	rcall	one_wire_init








